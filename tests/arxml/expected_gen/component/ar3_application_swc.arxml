AUTOSAR XML (schema 302)
package /ComponentTypes
  application software component type MyApplication
    require port VehicleSpeed: unqueued-receiver-com-spec{data-element=VehicleSpeed, init-value=VehicleSpeed_IV}, required-interface=VehicleSpeed_I
  internal behavior MyApplication_InternalBehavior: component=MyApplication, port-api-option{enable-take-address=false, indirect-api=false, port=VehicleSpeed}
  swc implementation MyApplication_Implementation: behavior=MyApplication_InternalBehavior
    code-descriptors:
      code Code: type=SRC
