AUTOSAR XML (schema 4-2-2)
package /ComponentTypes
  complex device driver sw component type MyService
    require port VehicleSpeed: nonqueued-receiver-com-spec{data-element=VehicleSpeed, filter=data-filter-type=ALWAYS, init-value=constant-reference=VehicleSpeed_IV}, required-interface=VehicleSpeed_I
    behavior MyService_InternalBehavior: port-api-option{enable-take-address=false, indirect-api=false, port=VehicleSpeed}
  swc implementation MyService_Implementation: behavior=MyService_InternalBehavior
    code-descriptors:
      code Default: artifact-descriptors=autosar-engineering-object={short-label=Default, category=SWSRC}
