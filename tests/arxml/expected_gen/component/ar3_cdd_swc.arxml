AUTOSAR XML (schema 302)
package /ComponentTypes
  complex device driver component type MyComplexDeviceDriver
    require port VehicleSpeed: unqueued-receiver-com-spec{data-element=VehicleSpeed, init-value=VehicleSpeed_IV}, required-interface=VehicleSpeed_I
  internal behavior MyComplexDeviceDriver_InternalBehavior: component=MyComplexDeviceDriver, port-api-option{enable-take-address=false, indirect-api=false, port=VehicleSpeed}
  swc implementation MyComplexDeviceDriver_Implementation: behavior=MyComplexDeviceDriver_InternalBehavior
    code-descriptors:
      code Code: type=SRC
