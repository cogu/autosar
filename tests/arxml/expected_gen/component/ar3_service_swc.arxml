AUTOSAR XML (schema 302)
package /ComponentTypes
  service component type MyService: category=ServiceComponent
    require port VehicleSpeed: unqueued-receiver-com-spec{data-element=VehicleSpeed, init-value=VehicleSpeed_IV}, required-interface=VehicleSpeed_I
  internal behavior MyService_InternalBehavior: component=MyService, port-api-option{enable-take-address=false, indirect-api=false, port=VehicleSpeed}
  swc implementation MyService_Implementation: behavior=MyService_InternalBehavior
    code-descriptors:
      code Code: type=SRC
