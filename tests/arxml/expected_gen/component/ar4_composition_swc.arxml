AUTOSAR XML (schema 4-2-2)
package /ComponentTypes
  composition sw component type MyComposition
    require port VehicleSpeed: nonqueued-receiver-com-spec{data-element=VehicleSpeed, filter=data-filter-type=ALWAYS, init-value=constant-reference=VehicleSpeed_IV}, required-interface=VehicleSpeed_I
