AUTOSAR XML (schema 4-2-2)
package /PortInterfaces
  parameter interface CruiseControlEnable_I
    parameter data prototype v: type=boolean
