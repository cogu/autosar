AUTOSAR XML (schema 302)
standard types defined: UInt8, UInt16, UInt32, Boolean
package /DataTypes
  4 x integer type, all with lower-limit=0:
    OffOn_T: compu {0=OffOn_Off, 1=OffOn_On, 2=OffOn_Error, 3=OffOn_NotAvailable}, upper-limit=3
    Seconds_T: upper-limit=63
    Minutes_T: upper-limit=63
    Hours_T: upper-limit=31
package /PortInterfaces
  sender receiver interface HeaterPwrStat_I
    data HeaterPwrStat: type=OffOn_T
