AUTOSAR XML (schema 4-2-2)
package /PortInterfaces
  client server interface FreeRunningTimer_I
    operation GetTimeStamp
      arg value: type=uint32, direction=OUT, server-argument-impl-policy=USE-ARGUMENT-TYPE  # The value of the timer
      arg reset: type=boolean, direction=IN, server-argument-impl-policy=USE-ARGUMENT-TYPE  # If true reset the timer
