AUTOSAR XML (schema 4-2-2)
standard types defined: boolean, uint8, uint16, uint32, boolean_DataConstr, uint8_DataConstr, uint16_DataConstr, uint32_DataConstr, float32
package /DataTypes
  4 x impl type, all with category=TYPE_REFERENCE, implementation-data-type=uint8:
    OffOn_T: compu {0=OffOn_Off, 1=OffOn_On, 2=OffOn_Error, 3=OffOn_NotAvailable}, range raw 0..3
    Seconds_T: range raw 0..63
    Minutes_T: range raw 0..63
    Hours_T: range raw 0..31
package /ModeDclrGroups
  mode declaration group VehicleMode: initial-mode=OFF
    4 x mode:
      OFF
      ACCESSORY
      RUNNING
      CRANKING
package /PortInterfaces
  nv data interface SystemTime_I: is-service=true, service-kind=NON-VOLATILE-RAM-MANAGER
    nv-datas:
      data Seconds: type=Seconds_T
      data Minutes: type=Minutes_T
      data Hours: type=Hours_T
