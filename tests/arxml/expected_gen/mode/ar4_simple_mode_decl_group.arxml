AUTOSAR XML (schema 4-2-2)
package /ModeDclrGroups
  mode declaration group BswM_Mode: initial-mode=STARTUP
    5 x mode:
      POSTRUN
      RUN
      SHUTDOWN
      STARTUP
      WAKEUP
