AUTOSAR XML (schema 4-2-2)
package /ModeDclrGroups
  mode declaration group BswM_ESH_Mode: initial-mode=STARTUP
    5 x mode:
      STARTUP: value=0
      RUN: value=1
      POSTRUN: value=2
      WAKEUP: value=3
      SHUTDOWN: value=4
