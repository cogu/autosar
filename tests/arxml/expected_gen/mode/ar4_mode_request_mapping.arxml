AUTOSAR XML (schema 4-2-2)
package /ModeDclrGroups
  mode declaration group BswM_ESH_Mode: initial-mode=STARTUP
    5 x mode:
      POSTRUN
      RUN
      SHUTDOWN
      STARTUP
      WAKEUP
  data type mapping set BswMMappingSet: mode-request-type-map{implementation-data-type=BswM_ESH_Mode, mode-group=BswM_ESH_Mode}
