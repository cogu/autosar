AUTOSAR XML (schema 4-2-2)
package /Constants
  constant specification Record1_IV: value-spec={short-label=Record1_IV, fields=[Elem1:[4294967295, 4294967295, 0, 0], Elem2:4294967295]}
