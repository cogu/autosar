AUTOSAR XML (schema 4-2-2)
package /Constants
  constant specification Phys_SteeringWheelAngle_IV: value-spec=[32.05 120.11 -36.345 22 58] deg
