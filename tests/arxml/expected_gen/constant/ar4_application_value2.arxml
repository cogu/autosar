AUTOSAR XML (schema 4-2-2)
package /Constants
  constant specification Phys_Calibration_IV: value-spec=63 over axis  kg
