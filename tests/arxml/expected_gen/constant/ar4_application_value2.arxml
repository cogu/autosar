AUTOSAR XML (schema 4-2-2)
package /Constants
  5 x constant specification:
    Phys_Calibration_IV: value-spec=63 over axis  kg
    Phys_Calibration_NAN_IV: value-spec=NaN over axis  kg
    Phys_Calibration_nINF_IV: value-spec=-INF
    Phys_Calibration_INF_IV: value-spec=INF
    Phys_Calibration_Text_IV: value-spec=TextValue
