AUTOSAR XML (schema 302)
package /Constant
  constant specification MyConstant
    value:
      array specification MyConstant: type=MyRecordArray_T
