AUTOSAR XML (schema 302)
package /Constant
  constant specification MyConstant
    value:
      array specification MyConstant: type=MyRecordArray_T
        record specification MyRecord_T_0: type=MyRecord_T
          integer literal Setting1: type=UInt8, value=255
          integer literal Setting2: type=UInt16, value=65535
          integer literal Setting3: type=UInt32, value=4294967295
        record specification MyRecord_T_1: type=MyRecord_T
          integer literal Setting1: type=UInt8, value=0
          integer literal Setting2: type=UInt16, value=0
          integer literal Setting3: type=UInt32, value=0
        record specification MyRecord_T_2: type=MyRecord_T
          integer literal Setting1: type=UInt8, value=255
          integer literal Setting2: type=UInt16, value=65535
          integer literal Setting3: type=UInt32, value=4294967295
