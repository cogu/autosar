AUTOSAR XML (schema 4-2-2)
package /Constants
  constant specification ArrayInArray_IV: value-spec=ArrayInArray_IV:[[1, 2, 3, 4], [5, 6, 7, 8]]
