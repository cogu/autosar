AUTOSAR XML (schema 4-2-2)
package /Constants
  constant specification Phys_SteeringWheelAngle_IV: value-spec=1.745329252 rad
