AUTOSAR XML (schema 302)
package /Constant
  constant specification WarningSignal_IV
    value:
      integer literal WarningSignal_IV: type=Warning3Bit_T, value=7
