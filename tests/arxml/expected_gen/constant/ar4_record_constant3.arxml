AUTOSAR XML (schema 4-2-2)
package /Constants
  constant specification Record2_IV: value-spec={short-label=Record2_IV, fields=[Elem1:4294967295, Elem2:32 x 0]}
