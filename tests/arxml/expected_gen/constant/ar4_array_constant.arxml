AUTOSAR XML (schema 4-2-2)
package /Constants
  constant specification u8Array2_IV: value-spec=u8Array2_IV:[0, 0]
