AUTOSAR XML (schema 4-2-2)
package /Constants
  constant specification RecordInRecord_IV: value-spec={short-label=RecordInRecord_IV, fields=[AlarmId:1, {short-label=AlarmProps, fields=[AlarmEnabled:True, AlarmTime:10000]}]}
