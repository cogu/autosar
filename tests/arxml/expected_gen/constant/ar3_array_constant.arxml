AUTOSAR XML (schema 302)
package /Constants
  constant specification u8Array2_IV
    value:
      array specification u8Array2_IV: type=u8Array2_T
        integer literal UInt8_0: type=UInt8, value=0
        integer literal UInt8_1: type=UInt8, value=0
