AUTOSAR XML (schema 4-2-2)
package /Constants
  constant specification CDiagNv_NvMServiceRequestType: value-spec=CDiagNv_NvMServiceRequestType:[fields=[ServiceId:0, RequestResult:0], fields=[ServiceId:1, RequestResult:0]]
