AUTOSAR XML (schema 4-2-2)
package /Constants
  constant specification Record_IV: value-spec={short-label=Record_IV, fields=[Elem1:OffOn_Off, Elem2:SparseInactiveActive_NotAvailable]}
