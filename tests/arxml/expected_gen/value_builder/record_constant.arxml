AUTOSAR XML (schema 4-2-2)
package /Constants
  constant specification Result_IV: value-spec={short-label=Result_IV, fields=[Status:0, ID:22, Message:OK]}
