AUTOSAR XML (schema 4-2-2)
package /Constants
  constant specification Array_IV: value-spec=Array_IV:[1, 2, 3]
