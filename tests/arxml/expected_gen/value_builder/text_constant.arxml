AUTOSAR XML (schema 4-2-2)
package /Constants
  constant specification Greeting_IV: value-spec=Hello World
