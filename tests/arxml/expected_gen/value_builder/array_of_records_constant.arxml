AUTOSAR XML (schema 4-2-2)
package /Constants
  constant specification CDiagNv_NvMServiceRequestType: value-spec=[fields=[SerciceId:0, RequestResult:0]]
