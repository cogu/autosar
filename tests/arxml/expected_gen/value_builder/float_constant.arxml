AUTOSAR XML (schema 4-2-2)
package /Constants
  constant specification Radians_IV: value-spec=1.745329252
