AUTOSAR XML (schema 4-2-2)
package /Constants
  constant specification FieldOfView_IV: value-spec=90
