AUTOSAR XML (schema 4-2-2)
package /ComponentTypes
  application sw component type MyApplication
    behavior MyApplication_InternalBehavior
  swc implementation MyApplication_Implementation: behavior=MyApplication_InternalBehavior
