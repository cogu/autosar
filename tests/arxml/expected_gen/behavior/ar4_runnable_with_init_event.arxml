AUTOSAR XML (schema 4-2-2)
package /ComponentTypes
  application sw component type MyApplication
    behavior MyApplication_InternalBehavior
      init event IT_MyApplication_Init: start-on-event=MyApplication_Init
      runnable MyApplication_Init
  swc implementation MyApplication_Implementation: behavior=MyApplication_InternalBehavior
    code-descriptors:
      code Default: artifact-descriptors=autosar-engineering-object={short-label=Default, category=SWSRC}
