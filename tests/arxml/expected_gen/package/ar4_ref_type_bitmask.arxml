AUTOSAR XML (schema 4-2-2)
standard types defined: boolean, uint8, uint16, uint32, boolean_DataConstr, uint8_DataConstr, uint16_DataConstr, uint32_DataConstr
package /DataTypes
  impl type DataTypeWithBitMask_T: compu {, , , , , , , }, range raw 0..255, implementation-data-type=uint8
