AUTOSAR XML (schema 4-2-2)
package /Constants
  constant specification UserName_IV: value-spec=UserName_IV:32 x 0
