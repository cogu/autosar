AUTOSAR XML (schema 4-2-2)
standard types defined: boolean, uint8, uint16, uint32, boolean_DataConstr, uint8_DataConstr, uint16_DataConstr, uint32_DataConstr
package /DataTypes
  impl type U32Test_T: implementation-data-type=uint32
  impl type Array4_T: category=ARRAY
    element Array4_T: array-size=4, array-size-semantics=FIXED-SIZE, implementation-data-type=U32Test_T
