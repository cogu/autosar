AUTOSAR XML (schema 4-2-2)
package /Constants
  constant specification U32Value_IV: value-spec=U32Value_IV:4294967295
