AUTOSAR XML (schema 4-2-2)
package /ComponentTypes
  application sw component type MyApplication
    require port VehicleSpeed: nonqueued-receiver-com-spec{data-element=VehicleSpeed, filter=data-filter-type=ALWAYS, init-value=constant-reference=VehicleSpeed_IV}, required-interface=VehicleSpeed_I
    behavior MyApplication_InternalBehavior: port-api-option{enable-take-address=false, indirect-api=false, port=VehicleSpeed}
  swc implementation MyApplication_Implementation: behavior=MyApplication_InternalBehavior
    code-descriptors:
      code Default: artifact-descriptors=autosar-engineering-object={short-label=Default, category=SWSRC}
