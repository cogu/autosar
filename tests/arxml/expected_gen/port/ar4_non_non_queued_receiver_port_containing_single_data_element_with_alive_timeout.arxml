AUTOSAR XML (schema 4-2-2)
package /ComponentTypes
  application sw component type MyApplication
    require port HeaterPwrStat: nonqueued-receiver-com-spec{data-element=HeaterPwrStat, alive-timeout=30, filter=data-filter-type=ALWAYS}, required-interface=HeaterPwrStat_I
    behavior MyApplication_InternalBehavior: port-api-option{enable-take-address=false, indirect-api=false, port=HeaterPwrStat}
  swc implementation MyApplication_Implementation: behavior=MyApplication_InternalBehavior
