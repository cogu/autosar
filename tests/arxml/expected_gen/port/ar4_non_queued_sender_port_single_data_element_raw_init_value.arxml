AUTOSAR XML (schema 4-2-2)
package /ComponentTypes
  application sw component type MyApplication
    provide port HeaterPwrStat: nonqueued-sender-com-spec{data-element=HeaterPwrStat, init-value=OffOn_NotAvailable}, provided-interface=HeaterPwrStat_I
    behavior MyApplication_InternalBehavior: port-api-option{enable-take-address=false, indirect-api=false, port=HeaterPwrStat}
  swc implementation MyApplication_Implementation: behavior=MyApplication_InternalBehavior
