AUTOSAR XML (schema 4-2-2)
package /DataTypes
  app type Pitch_ADT: compu {phys=raw/128-90 for raw 0..20340; unit deg}, range raw 0..20340, unit=deg
package /DataTypes/Units
  unit deg: display-name=deg
