AUTOSAR XML (schema 4-2-2)
package /DataTypes/CompuMethods
  compu method SensorToRaw_T: raw=phys*256 for phys 0..65535, else 65535; unit Raw
package /DataTypes/Units
  unit Raw: display-name=Raw
