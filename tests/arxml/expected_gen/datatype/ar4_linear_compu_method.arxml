AUTOSAR XML (schema 4-2-2)
package /DataTypes/CompuMethods
  compu method Pitch_T: phys=raw/128-0.703125 for raw 0..20340; unit deg
package /DataTypes/Units
  unit deg: display-name=deg
