AUTOSAR XML (schema 4-2-2)
package /DataTypes/DataConstrs
  range UINT8_ADT_DataConstr: phys 0..255
