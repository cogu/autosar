AUTOSAR XML (schema 4-2-2)
standard types defined: boolean, boolean_DataConstr
