AUTOSAR XML (schema 302)
standard types defined: UInt8, UInt16, UInt32
