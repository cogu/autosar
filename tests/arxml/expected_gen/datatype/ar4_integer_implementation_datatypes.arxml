AUTOSAR XML (schema 4-2-2)
standard types defined: uint8, uint16, uint32, uint8_DataConstr, uint16_DataConstr, uint32_DataConstr
