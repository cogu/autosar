AUTOSAR XML (schema 4-2-2)
package /DataTypes/DataConstrs
  range VehicleSpeed_DataConstr: raw 0..65535
