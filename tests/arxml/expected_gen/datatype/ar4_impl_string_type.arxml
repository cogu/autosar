AUTOSAR XML (schema 4-2-2)
standard types defined: boolean, uint8, uint16, uint32, boolean_DataConstr, uint8_DataConstr, uint16_DataConstr, uint32_DataConstr, float32
package /DataTypes
  impl type UserName_T: category=ARRAY
    element UserName_T: array-size=32, array-size-semantics=FIXED-SIZE, implementation-data-type=uint8
