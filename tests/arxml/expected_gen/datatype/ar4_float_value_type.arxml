AUTOSAR XML (schema 4-2-2)
standard types defined: boolean, uint8, uint16, uint32, float32, boolean_DataConstr, uint8_DataConstr, uint16_DataConstr, uint32_DataConstr, float32_DataConstr
