AUTOSAR XML (schema 4-2-2)
standard types defined: boolean, uint8, uint16, uint32, boolean_DataConstr, uint8_DataConstr, uint16_DataConstr, uint32_DataConstr, float32
package /DataTypes
  impl type OffOn_T: compu {0=OffOn_Off, 1=OffOn_On, 2=OffOn_Error, 3=OffOn_NotAvailable}, range raw 0..3, implementation-data-type=uint8
