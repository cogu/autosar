AUTOSAR XML (schema 4-2-2)
package /DataTypes
  app type UINT8_ADT: category=VALUE, sw-calibration-access=READ-ONLY, range phys 0..255
  application array data type Data2ByteType_ADT: category=ARRAY, sw-calibration-access=READ-ONLY
    element Data2ByteType_ADTElement: category=VALUE, type=UINT8_ADT, array-size-semantics=FIXED-SIZE, max-number-of-elements=2
