AUTOSAR XML (schema 4-2-2)
package /DataTypes/CompuMethods
  compu method VehicleSpeed_T: phys=raw/64 for raw 0..65535, else 65535; unit KmPerHour
package /DataTypes/Units
  unit KmPerHour: display-name=KmPerHour
