AUTOSAR XML (schema 302)
standard types defined: UInt8, UInt16, UInt32
package /DataType
  record type MyRecord_T
    record element UserId{1..3}: type=UInt16
