AUTOSAR XML (schema 302)
standard types defined: UInt8, UInt16, UInt32
package /DataType
  record type MyRecord_T
    record element Setting1: type=UInt8
    record element Setting2: type=UInt16
    record element Setting3: type=UInt32
  array type MyArray_T
    element MyArray_T: type=MyRecord_T, max-number-of-elements=8
