AUTOSAR XML (schema 4-2-2)
standard types defined: boolean, uint8, uint16, uint32, boolean_DataConstr, uint8_DataConstr, uint16_DataConstr, uint32_DataConstr, float32
package /DataTypes
  impl type RTCTime_T: category=VALUE, base-type=uint32, range raw 0..4294967295, type-emitter=RTE
    symbol props TimeStamp: symbol=TimeStampSym
