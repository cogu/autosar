AUTOSAR XML (schema 4-2-2)
package /DataTypes/Units
  unit deg: display-name=deg
