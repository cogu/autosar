AUTOSAR XML (schema 4-2-2)
package /DataTypes/DataConstrs
  range VehicleSpeedPhys_DataConstr: phys 0..65535
