AUTOSAR XML (schema 4-2-2)
standard types defined: boolean, uint8, uint16, uint32, boolean_DataConstr, uint8_DataConstr, uint16_DataConstr, uint32_DataConstr, float32
package /DataTypes
  impl type U32Type_T: implementation-data-type=uint32
  impl type RecordType1_T: category=STRUCTURE
    element Elem1: implementation-data-type=uint8
    element Elem2: implementation-data-type=U32Type_T
