AUTOSAR XML (schema 4-2-2)
standard types defined: boolean, uint8, uint16, uint32, boolean_DataConstr, uint8_DataConstr, uint16_DataConstr, uint32_DataConstr, float32
package /DataTypes
  impl type VehicleSpeed_T: compu {phys=raw/256 for raw 0..65535; unit KmPerHour}, range raw 0..65535, implementation-data-type=uint16, unit=KmPerHour
package /DataTypes/Units
  unit KmPerHour: display-name=KmPerHour
