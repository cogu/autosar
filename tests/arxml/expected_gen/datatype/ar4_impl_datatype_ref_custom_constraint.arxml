AUTOSAR XML (schema 4-2-2)
standard types defined: boolean, uint8, uint16, uint32, boolean_DataConstr, uint8_DataConstr, uint16_DataConstr, uint32_DataConstr, float32
package /DataTypes
  impl type U32RefCustom_T: range raw 0..100000, implementation-data-type=uint32
