AUTOSAR XML (schema 4-2-2)
package /DataTypes
  4 x app type:
    Pitch_ADT: compu {phys=raw/128-90 for raw 0..20340; unit deg}, range raw 0..20340, unit=deg
    Yaw_ADT: compu {phys=raw/128 for raw 0..46080; unit deg}, range raw 0..46080, unit=deg
    Altitude_ADT: compu {phys=raw*0.125-2500 for raw 0..65535; unit m}, range raw 0..65535, unit=m
    VehicleSpeed_ADT: compu {phys=raw/64 for raw 0..65535; unit kmPerHour}, range raw 0..65535, unit=kmPerHour
  application record data type Velocity_ADT: category=STRUCTURE
    4 x application record element, all with category=VALUE:
      Bearing: type=Yaw_ADT
      VehicleSpeed: type=VehicleSpeed_ADT
      Pitch: type=Pitch_ADT
      Altitude: type=Altitude_ADT
package /DataTypes/Units
  unit deg: display-name=deg
  unit m: display-name=m
  unit kmPerHour: display-name=kmPerHour
