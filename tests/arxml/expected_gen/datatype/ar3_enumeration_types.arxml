AUTOSAR XML (schema 302)
package /DataType
  integer type InactiveActive_T: compu {0=InactiveActive_Inactive, 1=InactiveActive_Active, 2=InactiveActive_Error, 3=InactiveActive_NotAvailable}, lower-limit=0, upper-limit=3
