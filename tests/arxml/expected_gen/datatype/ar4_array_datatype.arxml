AUTOSAR XML (schema 4-2-2)
standard types defined: boolean, uint8, uint16, uint32, boolean_DataConstr, uint8_DataConstr, uint16_DataConstr, uint32_DataConstr, float32
package /DataTypes
  impl type u8Array2_T: category=ARRAY
    element u8Array2_T: array-size=2, array-size-semantics=FIXED-SIZE, implementation-data-type=uint8
