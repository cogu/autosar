AUTOSAR XML (schema 4-2-2)
package /DataTypes
  app type UINT8_ADT: category=VALUE, sw-calibration-access=READ-ONLY, range phys 0..255
