AUTOSAR XML (schema 4-2-2)
standard types defined: boolean, uint8, uint16, uint32, boolean_DataConstr, uint8_DataConstr, uint16_DataConstr, uint32_DataConstr, float32
package /DataTypes
  impl type DataTypeWithBitMask_T: compu {mask 1: 1=MASK1, mask 2: 2=MASK2, mask 4: 4=MASK4, mask 8: 8=MASK8, mask 16: 16=MASK16, mask 32: 32=MASK32, mask 64: 64=MASK64, mask 128: 128=MASK128}, range raw 0..255, implementation-data-type=uint8
