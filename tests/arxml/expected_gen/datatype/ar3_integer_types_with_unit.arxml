AUTOSAR XML (schema 302)
package /DataType
  integer type Percent_T: compu {phys=raw*0.4 for raw 0..255; unit Percent}, lower-limit=0, upper-limit=255
  integer type VehicleSpeed_T: compu {phys=raw/64 for raw 0..65535; unit KmPerHour}, lower-limit=0, upper-limit=65535
package /DataType/Units
  unit Percent: display-name=Percent
  unit KmPerHour: display-name=KmPerHour
