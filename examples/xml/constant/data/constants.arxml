AUTOSAR XML (schema 00051)
package /Constants
  13 x constant specification:
    IntNoLabel: value-spec=1
    IntConstant: value-spec=Label1:1
    FloatNoLabel: value-spec=2.5
    FloatConstant: value-spec=Label2:2.5
    TextNoLabel: value-spec=TextValue
    TextConstant: value-spec=Label3:TextData
    ArrayNoLabel: value-spec=[1, 2, 3, 4]
    ArrayConstant: value-spec=Label4:[1, 2, 3, 4]
    RecordNoLabel: value-spec=fields=[Value1, Value2, 3]
    RecordConstant: value-spec={short-label=Label5, fields=[Value1, Value2, 3]}
    RecordWithReferences: value-spec=fields=[{short-label=First, constant=FloatConstant}, {short-label=Second, constant=TextConstant}]
    RefValueConstant: value-spec=EngineSpeed
    RecordWithRefValue: value-spec=fields=[EngineSpeedRef, {short-label=TargetData, reference-value=EngineSpeed}]
