AUTOSAR XML (schema 00050)
package /BaseTypes
  base type Typename
