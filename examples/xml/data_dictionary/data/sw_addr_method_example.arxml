AUTOSAR XML (schema 00050)
package /SwAddrMethod
  sw addr method DEFAULT
