AUTOSAR XML (schema 00051)
package /DataTypes/ImplementationDataTypes
  impl type InactiveActive_T: category=VALUE, base-type=uint8
