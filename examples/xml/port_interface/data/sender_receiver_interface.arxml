AUTOSAR XML (schema 00051)
package /PortInterfaces
  sender receiver interface HeadLightStatus_I
    data HeadLightStatus: type=InactiveActive_T
  sender receiver interface InterfaceName
    data Element1: type=InactiveActive_T
    data Element2: type=InactiveActive_T
