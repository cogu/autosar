AUTOSAR XML (schema 00051)
package /PortInterfaces
  sender receiver interface HeadLightStatus_I
    data HeadLightStatus: type=InactiveActive_T
