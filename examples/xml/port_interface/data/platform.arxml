AUTOSAR XML (schema 00051)
standard types defined: uint8, uint32
