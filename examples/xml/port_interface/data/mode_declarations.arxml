AUTOSAR XML (schema 00051)
package /ModeDeclarations
  mode declaration group VehicleMode: initial-mode=OFF
    4 x mode:
      OFF
      ACCESSORY
      RUNNING
      CRANKING
