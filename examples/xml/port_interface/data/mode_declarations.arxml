AUTOSAR XML (schema 00051)
package /ModeDeclarations
  mode declaration group VehicleMode: initial-mode=OFF
    5 x mode:
      OFF
      PARKING
      ACCESSORY
      CRANKING
      RUNNING
