AUTOSAR XML (schema 00051)
package /PortInterfaces
  mode switch interface VehicleMode_I
    mode group mode: type=VehicleMode
