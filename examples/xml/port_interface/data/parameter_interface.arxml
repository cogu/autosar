AUTOSAR XML (schema 00051)
package /PortInterfaces
  parameter interface ParameterInterface1
    parameter data prototype Param1: type=uint8
  parameter interface ParameterInterface2
    parameter data prototype Param1: type=uint8
    parameter data prototype Param2: type=uint32
