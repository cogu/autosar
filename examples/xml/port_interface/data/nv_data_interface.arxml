AUTOSAR XML (schema 00051)
package /PortInterfaces
  nv data interface DataInterface1
    nv-datas:
      data Data1: type=uint8
  nv data interface DataInterface2
    nv-datas:
      data Data1: type=uint8
      data Data2: type=uint32
