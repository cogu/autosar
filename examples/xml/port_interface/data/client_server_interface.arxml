AUTOSAR XML (schema 00051)
package /PortInterfaces
  client server interface FreeRunningTimer_I: is-service=true
    operation GetTimeStamp
      arg value: type=uint32, direction=OUT, server-argument-impl-policy=USE-ARGUMENT-TYPE
