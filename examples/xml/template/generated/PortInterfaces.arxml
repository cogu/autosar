AUTOSAR XML (schema 00051)
package /ModeDclrGroups
  mode declaration group EcuM_Mode: initial-mode=STARTUP
    6 x mode:
      STARTUP
      RUN
      POST_RUN
      SLEEP
      WAKEUP
      SHUTDOWN
package /PortInterfaces
  mode switch interface EcuM_CurrentMode: is-service=true
    mode group currentMode: type=EcuM_Mode
  client server interface NvMService_I: is-service=true
    operation EraseBlock: possible-error=E_NOT_OK
    error E_NOT_OK: error-code=1
