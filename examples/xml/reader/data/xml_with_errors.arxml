AUTOSAR XML (schema 00051)
package /Constants
  5 x constant specification:
    C_HazardSwitchIllumination_IV: value-spec=C_HazardSwitchIllumination_IV:0
    C_TelltaleBrightness_IV: value-spec=C_TelltaleBrightness_IV:FiftyFive
    C_HazardSwitchIllumination_IV: value-spec=C_HazardSwitchIllumination_IV:0
    C_LightSensor_IV: value-spec=C_LightSensor_IV:65535
    C_HazardSwitchIllumination_IV: value-spec=C_HazardSwitchIllumination_IV:0
