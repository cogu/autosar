AUTOSAR XML (schema 00051)
package /BaseTypes
  base type Typename
