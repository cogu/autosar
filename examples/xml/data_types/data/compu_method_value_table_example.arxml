AUTOSAR XML (schema 00050)
standard types defined: boolean
