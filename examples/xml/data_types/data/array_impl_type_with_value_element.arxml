AUTOSAR XML (schema 00051)
standard types defined: uint8
package /DataTypes/ImplementationDataTypes
  impl type U8Array4_T: category=ARRAY
    element Element: category=VALUE, array-size=4, base-type=uint8
