AUTOSAR XML (schema 00051)
standard types defined: uint8
package /DataTypes/ImplementationDataTypes
  impl type InactiveActive_T: category=VALUE, base-type=uint8
  impl type InactiveActiveArray2_T: category=ARRAY
    element Element: array-size=2, implementation-data-type=InactiveActive_T
