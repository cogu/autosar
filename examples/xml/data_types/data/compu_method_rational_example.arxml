AUTOSAR XML (schema 00051)
package /CompuMethods
  compu method VehicleSpeed_T: phys=raw/64 for raw 0..65535, else 65535
