AUTOSAR XML (schema 00050)
package /DataTypes/ApplicationDataTypes
  app type uint8_ADT: category=VALUE, range raw 0..255
