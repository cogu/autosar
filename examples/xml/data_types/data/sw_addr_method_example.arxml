AUTOSAR XML (schema 00051)
package /SwAddrMethod
  sw addr method DEFAULT
