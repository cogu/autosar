AUTOSAR XML (schema 00051)
package /ComponentTypes
  application sw component type SWC
