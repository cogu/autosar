AUTOSAR XML (schema 00051)
standard types defined: boolean, uint8, uint16, uint32, boolean_DataConstr, boolean_CompuMethod
