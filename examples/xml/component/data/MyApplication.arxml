AUTOSAR XML (schema 00051)
package /ComponentTypes
  application sw component type MyApplication
    require port VehicleSpeed: nonqueued-receiver-com-spec{data-element=VehicleSpeed, init-value=65535}, required-interface=VehicleSpeed_I
    require port FreeRunningTimer: required-interface=FreeRunningTimer_I
