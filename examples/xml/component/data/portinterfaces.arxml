AUTOSAR XML (schema 00051)
package /PortInterfaces
  sender receiver interface VehicleSpeed_I
    data VehicleSpeed: type=uint16
  sender receiver interface EngineSpeed_I
    data EngineSpeed: type=uint16
  client server interface FreeRunningTimer_I
    operation GetTime
      arg value: type=uint32, direction=OUT
    operation IsTimerElapsed
      arg startTime: type=uint32, direction=IN
      arg duration: type=uint32, direction=IN
      arg result: type=boolean, direction=OUT
