AUTOSAR XML (schema 00051)
package /Constants
  constant specification VehicleSpeed_IV: value-spec=65535
  constant specification EngineSpeed_IV: value-spec=65535
