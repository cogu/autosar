AUTOSAR XML (schema 00050)
package /Units
  unit KmPerHour: display-name=KmPerHour
