AUTOSAR XML (schema 00051)
package /Units
  unit KmPerHour: display-name=KmPerHour
