AUTOSAR XML (schema 00051)
package /DataTypes/ImplementationDataTypes
  impl type InactiveActive_T: category=VALUE, base-type=uint8, compu {0=InactiveActive_Inactive, 1=InactiveActive_Active}, range raw 0..1
