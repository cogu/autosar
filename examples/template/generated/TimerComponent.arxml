AUTOSAR XML (schema 00051)
package /ComponentTypes
  application sw component type TimerComponent
    provide port FreeRunningTimer: provided-com-specs=[{operation=GetTime, queue-length=1}, {operation=IsTimerElapsed, queue-length=1}], provided-interface=FreeRunningTimer_I
    behavior TimerComponent_InternalBehavior
  swc implementation TimerComponent_Implementation: behavior=TimerComponent_InternalBehavior
