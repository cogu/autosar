AUTOSAR XML (schema 00051)
standard types defined: boolean, uint8, uint16, uint32, uint64, boolean_DataConstr, uint8_DataConstr, uint16_DataConstr, uint32_DataConstr, uint64_DataConstr, boolean_CompuMethod
