AUTOSAR XML (schema 302)
package /DataType
  6 x integer type, all with lower-limit=0:
    EngineSpeed_T: compu {phys=raw*0.125; unit rpm}, upper-limit=65535
    VehicleSpeed_T: compu {phys=raw/64; unit kph}, upper-limit=65535
    Percent_T: compu {phys=raw*0.4; unit Percent}, upper-limit=255
    CoolantTemp_T: compu {phys=raw*0.5-20; unit DegreeC}, upper-limit=255
    InactiveActive_T: compu {0=InactiveActive_Inactive, 1=InactiveActive_Active, 2=InactiveActive_Error, 3=InactiveActive_NotAvailable}, upper-limit=3
    OnOff_T: compu {0=OnOff_Off, 1=OnOff_On, 2=OnOff_Error, 3=OnOff_NotAvailable}, upper-limit=3
package /DataType/DataTypeUnits
  4 x unit:
    rpm: display-name=rpm
    kph: display-name=kph
    Percent: display-name=Percent
    DegreeC: display-name=DegreeC
