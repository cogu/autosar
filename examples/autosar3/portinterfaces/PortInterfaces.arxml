AUTOSAR XML (schema 302)
package /PortInterface
  6 x sender receiver interface:
    EngineSpeed_I
      data EngineSpeed: type=EngineSpeed_T
    VehicleSpeed_I
      data VehicleSpeed: type=VehicleSpeed_T
    FuelLevel_I
      data FuelLevel: type=Percent_T
    CoolantTemp_I
      data CoolantTemp: type=CoolantTemp_T
    InactiveActive_I
      data InactiveActive: type=InactiveActive_T
    OnOff_I
      data OnOff: type=OnOff_T
