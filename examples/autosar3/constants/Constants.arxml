AUTOSAR XML (schema 302)
package /Constant
  6 x constant specification:
    EngineSpeed_IV
      value:
        integer literal EngineSpeed_IV: type=EngineSpeed_T, value=0
    VehicleSpeed_IV
      value:
        integer literal VehicleSpeed_IV: type=VehicleSpeed_T, value=0
    FuelLevel_IV
      value:
        integer literal FuelLevel_IV: type=Percent_T, value=0
    CoolantTemp_IV
      value:
        integer literal CoolantTemp_IV: type=CoolantTemp_T, value=0
    ParkBrakeState_IV
      value:
        integer literal ParkBrakeState_IV: type=InactiveActive_T, value=3
    MainBeamState_IV
      value:
        integer literal MainBeamState_IV: type=OnOff_T, value=3
