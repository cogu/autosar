AUTOSAR XML (schema 4-2-2)
standard types defined: uint8_DataConstr, uint8
package /DataTypes/ImplementationTypes
  impl type MyU8PtrType: category=DATA_REFERENCE, sw-pointer-target-props={target-category=VALUE, base-type=uint8}
