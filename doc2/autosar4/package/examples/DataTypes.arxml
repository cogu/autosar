AUTOSAR XML (schema 4-2-2)
standard types defined: uint8_DataConstr, uint8
package /DataTypes/ImplementationTypes
  impl type MyType: implementation-data-type=uint8
